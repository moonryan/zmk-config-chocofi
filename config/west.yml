## config/west.yml
```yaml
manifest:
  remotes:
    - name: zmkfirmware
      url-base: https://github.com/zmkfirmware
    - name: gpeye                         # https://github.com/GPeye/urchin-peripheral-animation?tab=readme-ov-file#usage
      url-base: https://github.com/GPeye
  projects:
    - name: zmk
      remote: zmkfirmware
      revision: main
      import: app/west.yml
    - name: urchin-peripheral-animation
      remote: gpeye
      revision: main
  self:
    path: config
```
